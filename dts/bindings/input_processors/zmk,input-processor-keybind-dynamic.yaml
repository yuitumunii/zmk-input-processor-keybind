## dts/bindings/input_processors/zmk,input-processor-keybind-dynamic.yaml
```yaml
# Copyright (c) 2026, The ZMK Contributors
# SPDX-License-Identifier: MIT

description: >
  Dynamic (layer-aware) trackball gesture input processor.
  Inspects the highest active layer on every event and fires the
  per-layer configured binding.  Layers with no entry pass cursor
  events through unchanged.

compatible: "zmk,input-processor-keybind-dynamic"

include: ip_zero_param.yaml

properties:
  "#input-processor-cells":
    type: int
    const: 0
  mode:
    type: int
    description: >
      Motion-to-direction quantisation mode:
        0 = raw (X/Y accumulate separately)
        1 = 4-way DPad (dominant axis, default)
        2 = 8-way DPad
    default: 1
  track_remainders:
    type: boolean
    description: >
      Carry sub-tick remainder movement into the next event.
      Recommended so small flicks are never silently dropped.
  tick:
    type: int
    description: >
      Accumulated-movement units required to fire one key event.
      Higher = larger flick needed.  Default 180.
    default: 180
  wait-ms:
    type: int
    description: >
      Gap (ms) inserted after releasing a direction key before the
      next press can fire.  Default 600.
    default: 600
  tap-ms:
    type: int
    description: >
      Delay (ms) between the key-press and key-release within one
      tap.  Default 10.
    default: 10
  threshold:
    type: int
    description: >
      Minimum per-event absolute value to pass the threshold filter.
      Events smaller than this are discarded.  Default 1.
    default: 1
  max_threshold:
    type: int
    description: >
      Maximum per-event absolute value.  Events larger are discarded
      (avoids spurious large jumps).  Default 200.
    default: 200
  max_pending_activations:
    type: int
    description: >
      Cap on accumulated-movement units per axis (expressed as a
      multiple of tick).  Prevents runaway accumulation.  Default 5.
    default: 5
  guard-layers:
    type: array
    description: >
      Layer indices that are always passed through to normal cursor
      processing even if they have an entry in the binding table.
      Typically the MOUSE auto-layer and the scroller layer.
      Example: <6 7>
```

## src/pointing/Kconfig
```kconfig
# Copyright (c) 2023 The ZMK Contributors
# SPDX-License-Identifier: MIT

if ZMK_POINTING

config ZMK_INPUT_PROCESSOR_KEYBIND
    bool "Split Payload Compression Input Processor"
    default y
    depends on DT_HAS_ZMK_INPUT_PROCESSOR_KEYBIND_ENABLED

config ZMK_INPUT_PROCESSOR_KEYBIND_CODES_MAX_LEN
    int "Maximum codes length"
    default 4

config ZMK_INPUT_PROCESSOR_KEYBIND_STUDIO_RPC
    bool "Live gesture tuning over a custom Studio RPC subsystem"
    default n
    depends on ZMK_INPUT_PROCESSOR_KEYBIND && ZMK_STUDIO
    help
      Exposes each zip_keybind processor's tick / wait-ms / threshold params
      over a custom Studio RPC subsystem so they can be changed live from the
      desktop app without reflashing. Requires a ZMK base with custom-subsystem
      support (cormoran custom-studio-protocol).

config ZMK_INPUT_PROCESSOR_KEYBIND_DYNAMIC
    bool "Dynamic (layer-aware) trackball gesture input processor"
    default y
    depends on DT_HAS_ZMK_INPUT_PROCESSOR_KEYBIND_DYNAMIC_ENABLED
    help
      Adds the zip_keybind_dynamic processor which inspects the highest
      active layer on every trackball event and fires per-layer configured
      bindings.  Layers with no binding configured pass events through so
      normal cursor processing is unaffected.

endif
```
